## conf/layer.conf
```bitbake
# We have a conf and classes directory, add to BBPATH
BBPATH .= ":${LAYERDIR}"

# We have recipes-* directories, add to BBFILES
BBFILES += "${LAYERDIR}/recipes-*/*/*.bb \
            ${LAYERDIR}/recipes-*/*/*.bbappend"

BBFILE_COLLECTIONS += "meta-casanode"
BBFILE_PATTERN_meta-casanode = "^${LAYERDIR}/"
BBFILE_PRIORITY_meta-casanode = "10"

LAYERDEPENDS_meta-casanode = "core"
LAYERSERIES_COMPAT_meta-casanode = "scarthgap"
```
